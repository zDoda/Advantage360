#define VERSION_MACRO
macro_ver: macro_ver {
compatible = "zmk,behavior-macro";
label = "macro_ver";
#binding-cells = <0>;
bindings = <&kp N2>, <&kp N0>, <&kp N2>, <&kp N4>, <&kp N1>, <&kp N0>, <&kp N0>, <&kp N3>, <&kp MINUS>, <&kp M>, <&kp A>, <&kp I>, <&kp N>, <&kp MINUS>, <&kp N4>, <&kp C>, <&kp A>, <&kp N6>, <&kp B>, <&kp N5>, <&kp N9>, <&kp RET>;
};
